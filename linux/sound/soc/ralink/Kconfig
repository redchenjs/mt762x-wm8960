## linux/sound/soc/ralink/Kconfig
```kconfig
config SND_SOC_RALINK_I2S
    depends on RALINK && SND_SOC && !SOC_RT288X
    select SND_SOC_GENERIC_DMAENGINE_PCM
    select REGMAP_MMIO
    select DMA_RALINK
    select DMADEVICES
    tristate "SoC Audio (I2S protocol) for Ralink SoC"
    help
      Say Y if you want to use I2S protocol and I2S codec on Ralink/MediaTek
      based boards.

config SND_SOC_MT76X8_WM8960
    tristate "WM8960 SoC Audio support for MT76x8 SoC"
    select SND_SOC_RALINK_I2S
    select SND_SIMPLE_CARD
    select SND_SOC_WM8960
    select I2C_MT7621
    select SND_HWDEP
    select I2C
```

## mt76x8-wm8960/src/Kconfig
```kconfig
config SND_SOC_MT76X8_WM8960
	tristate "WM8960 SoC Audio support for MT76x8 SoC"
	select SND_RALINK_SOC_I2S
	select SND_SIMPLE_CARD
	select SND_SOC_WM8960
	select I2C_MT7621
	select SND_HWDEP
	select I2C
```

## src/Kconfig
```kconfig
config SND_SOC_MT762X_WM8960
	tristate "ASoC Audio driver for Ralink SoC with WM8960 codec"
	depends on SND_RALINK_SOC_I2S && I2C
	select SND_SOC_WM8960
	help
	  Say Y if you want to use WM8960 codec on Ralink/MediaTek based boards.
```
